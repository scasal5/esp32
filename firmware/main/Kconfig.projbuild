## firmware/main/Kconfig.projbuild
```kconfig
menu "ws183-os"

    comment "Cada app se registra en app_main.c detras de su opcion."

    config WS183_APP_FONDO
        bool "App Fondo"
        default y
        help
            Tarjeta "Fondo": con WiFi muestra un QR a la IP de la placa para
            subir png/jpg/gif. El celular se acepta por MAC, igual que el
            portal de clave. Sin WiFi avisa que hace falta conexion.

    config WS183_APP_ASPECTO
        bool "App Aspecto"
        default y
        help
            Tarjeta "Aspecto" en el lanzador. Todavia no abre nada; la tarjeta
            solo avisa que viene.

    config WS183_APP_WIFI
        bool "App WiFi"
        default y
        help
            Tarjeta "WiFi": scan de redes cercanas, QR y SoftAP de provision.
            Apagarla saca la tarjeta y el handler de eventos de svc_wifi; el
            servicio de WiFi y los comandos de consola siguen andando.

    config WS183_APP_FLAPPY
        bool "App Flappy Bird"
        default y
        help
            Tarjeta "Flappy Bird": clon jugable (gravedad, flap, tubos, puntaje).
            Toque o BOOT = flap. Salir con doble toque en "Salir" (PWR/PEKEY
            no se puede interceptar: apaga por el AXP2101).

    config WS183_APP_AJUSTES
        bool "App Ajustes"
        default y
        help
            Tarjeta "Ajustes" en el lanzador. Todavia no abre nada; la tarjeta
            solo avisa que viene.

    config WS183_COMPANION
        bool "Companion (SoftAP portal + Fondo HTTP)"
        default y
        help
            Portal SoftAP en 192.168.4.1 (GET /, GET /status, POST /connect
            form-urlencoded) y HTTP de Fondo para subir splash.png/gif.
            Apagarlo deshabilita ambas UIs HTTP del celular; STA, scan y el
            resto del firmware siguen. Ver docs/companion.md.

    config WS183_PROV_AUTO_ALLOW
        bool "Lab: auto-allow SoftAP client (skip Si/No)"
        depends on WS183_COMPANION
        default n
        help
            Solo lab/harness. Cuando el primer cliente se asocia al SoftAP,
            llama a svc_wifi_prov_allow() sin tocar Si en la placa. No usar
            en builds de produccion. Ver docs/companion.md.

endmenu
```

## pocketjs-s3-harness/main/Kconfig.projbuild
```kconfig
menu "ws183 harness"
config HARNESS_WIFI
    bool "Initialize STA (otherwise Wi-Fi is never initialized)"
    default n
config HARNESS_GOLDEN
    bool "Reference framebuffer checks (not a PERF build)"
    default n
config HARNESS_DOUBLE_BOUNCE
    bool "Second DMA bounce for follow-up latency experiment"
    default n
config HARNESS_HEAP_BYTES
    int "QuickJS heap limit"
    default 1048576
config HARNESS_STACK_BYTES
    int "Owner internal task stack in bytes"
    default 32768
config HARNESS_JS_STACK_BYTES
    int "QuickJS stack limit in bytes"
    default 24576
config HARNESS_SMOKE_TICKS
    int "Short smoke tick count"
    default 10000
config HARNESS_SOAK_SECONDS
    int "Soak duration"
    default 7200
endmenu
```
